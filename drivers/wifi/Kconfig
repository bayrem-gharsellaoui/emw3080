## drivers/wifi/Kconfig
```kconfig
# Copyright (c) 2026 Bayrem Gharsellaoui
# SPDX-License-Identifier: Apache-2.0

# menu "emw3080"
rsource "emw3080/Kconfig"
```

## drivers/wifi/emw3080/Kconfig
```kconfig
# Copyright (c) 2026 Bayrem Gharsellaoui
# SPDX-License-Identifier: Apache-2.0

menuconfig EMW3080
	bool "MXCHIP EMW3080 Wi-Fi driver"
	depends on WIFI
	depends on DT_HAS_MXCHIP_EMW3080_ENABLED
	select SPI
	select GPIO
	select NET_L2_WIFI_MGMT
	select WIFI_OFFLOAD
	select NET_OFFLOAD
	help
	  Enable support for the MXCHIP EMW3080 Wi-Fi module.

if EMW3080

config EMW3080_INIT_PRIORITY
	int "EMW3080 device initialization priority"
	default 60
	help
	  Initialization priority of the EMW3080 device.

module = EMW3080
module-str = emw3080
source "subsys/logging/Kconfig.template.log_config"

endif # EMW3080
```

## dts/bindings/wifi/mxchip,emw3080.yaml
```yaml
# Copyright (c) 2026 Bayrem Gharsellaoui
# SPDX-License-Identifier: Apache-2.0

description: MXCHIP EMW3080 Wi-Fi module

compatible: "mxchip,emw3080"

include: spi-device.yaml

properties:
  enable-gpios:
    type: phandle-array
    required: true
    description: GPIO used to enable the Wi-Fi module.

  flow-gpios:
    type: phandle-array
    required: true
    description: GPIO indicating the module is ready for an SPI transfer.

  notify-gpios:
    type: phandle-array
    required: true
    description: GPIO indicating the module has data available.
```

## west.yml
```yaml
# Copyright (c) 2026 Bayrem Gharsellaoui
# SPDX-License-Identifier: Apache-2.0

manifest:
  version: "1.2"

  defaults:
    remote: zephyrproject

  remotes:
    - name: zephyrproject
      url-base: https://github.com/zephyrproject-rtos

    - name: bayrem
      url-base: https://github.com/bayrem-gharsellaoui

  projects:
    - name: zephyr
      repo-path: zephyr
      remote: bayrem
      revision: wifi-emw3080
      path: zephyr
      west-commands: scripts/west-commands.yml
      import:
        name-allowlist:
          - cmsis_6
          - hal_stm32

  self:
    path: emw3080
```
